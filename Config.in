## Config.in
```kconfig
config BR2_PACKAGE_SHARED_SECURE_PERIPHERALS
	bool "shared-secure-peripherals"
	depends on BR2_LINUX_KERNEL
	depends on BR2_TARGET_OPTEE_OS
	select BR2_PACKAGE_NORMAL_CONTROLLER
	select BR2_PACKAGE_NORMAL_SSP_DRIVER
	help
	  Enables the use of shared secure peripherals in OP-TEE OS.

	  https://github.com/Distrinet-TACOS/shared-secure-peripherals

source "$BR2_EXTERNAL_SHARED_SECURE_PERIPHERALS_PATH/package/normal-controller/Config.in"
source "$BR2_EXTERNAL_SHARED_SECURE_PERIPHERALS_PATH/package/normal-ssp-driver/Config.in"
source "$BR2_EXTERNAL_SHARED_SECURE_PERIPHERALS_PATH/package/linux-watchdog/Config.in"
```

## configs/imx6q_sabrelite_defconfig
```kconfig
BR2_arm=y
BR2_cortex_a9=y
BR2_ARM_ENABLE_NEON=y
BR2_ARM_ENABLE_VFP=y
BR2_ARM_FPU_VFPV3=y
BR2_GLOBAL_PATCH_DIR="$(BR2_EXTERNAL_BOUNDARY_PATH)/patches/"
BR2_TOOLCHAIN_EXTERNAL=y
BR2_TOOLCHAIN_EXTERNAL_GDB_SERVER_COPY=y
BR2_ROOTFS_DEVICE_CREATION_DYNAMIC_EUDEV=y
BR2_TARGET_GENERIC_GETTY_PORT="ttymxc0"
BR2_ROOTFS_OVERLAY="$(BR2_EXTERNAL_BOUNDARY_PATH)/board/boundarydevices/common/overlay"
BR2_ROOTFS_POST_BUILD_SCRIPT="$(BR2_EXTERNAL_BOUNDARY_PATH)/board/boundarydevices/mainline/post-build.sh"
BR2_ROOTFS_POST_IMAGE_SCRIPT="$(BR2_EXTERNAL_BOUNDARY_PATH)/board/boundarydevices/common/post-image.sh $(BR2_EXTERNAL_SHARED_SECURE_PERIPHERALS_PATH)/post-image.sh"
BR2_LINUX_KERNEL=y
BR2_LINUX_KERNEL_CUSTOM_GIT=y
BR2_LINUX_KERNEL_CUSTOM_REPO_URL="https://github.com/Distrinet-TACOS/linux.git"
BR2_LINUX_KERNEL_CUSTOM_REPO_VERSION="imx"
BR2_LINUX_KERNEL_DEFCONFIG="imx_v6_v7"
BR2_LINUX_KERNEL_DTS_SUPPORT=y
BR2_LINUX_KERNEL_INTREE_DTS_NAME="imx6q-sabrelite"
BR2_LINUX_KERNEL_INSTALL_TARGET=y
BR2_LINUX_KERNEL_NEEDS_HOST_OPENSSL=y
BR2_PACKAGE_BUSYBOX_SHOW_OTHERS=y
BR2_PACKAGE_STRACE=y
BR2_PACKAGE_FREESCALE_IMX=y
BR2_PACKAGE_FREESCALE_IMX_PLATFORM_IMX6Q=y
BR2_PACKAGE_FIRMWARE_IMX=y
BR2_PACKAGE_I2C_TOOLS=y
BR2_PACKAGE_UBOOT_TOOLS=y
BR2_PACKAGE_LIBIIO=y
BR2_PACKAGE_LIBIIO_TESTS=y
BR2_PACKAGE_LIBV4L=y
BR2_PACKAGE_LIBV4L_UTILS=y
BR2_PACKAGE_CAN_UTILS=y
BR2_PACKAGE_OPTEE_BENCHMARK=y
BR2_PACKAGE_OPTEE_CLIENT_CUSTOM_GIT=y
BR2_PACKAGE_OPTEE_CLIENT_CUSTOM_REPO_URL="https://github.com/Distrinet-TACOS/optee_client.git"
BR2_PACKAGE_OPTEE_CLIENT_CUSTOM_REPO_VERSION="master"
BR2_PACKAGE_OPTEE_EXAMPLES=y
BR2_PACKAGE_OPTEE_EXAMPLES_CUSTOM_GIT=y
BR2_PACKAGE_OPTEE_EXAMPLES_CUSTOM_REPO_URL="https://github.com/Distrinet-TACOS/optee_examples.git"
BR2_PACKAGE_OPTEE_EXAMPLES_CUSTOM_REPO_VERSION="master"
BR2_PACKAGE_OPTEE_TEST=y
BR2_PACKAGE_ANDROID_TOOLS=y
BR2_TARGET_ROOTFS_EXT2=y
BR2_TARGET_ROOTFS_EXT2_4=y
BR2_TARGET_ROOTFS_EXT2_SIZE="1024M"
BR2_TARGET_OPTEE_OS=y
BR2_TARGET_OPTEE_OS_CUSTOM_GIT=y
BR2_TARGET_OPTEE_OS_CUSTOM_REPO_URL="https://github.com/Distrinet-TACOS/optee_os.git"
BR2_TARGET_OPTEE_OS_CUSTOM_REPO_VERSION="imx"
BR2_TARGET_OPTEE_OS_PLATFORM="imx-mx6qsabrelite"
BR2_TARGET_OPTEE_OS_PLATFORM_FLAVOR="mx6qsabrelite"
BR2_TARGET_OPTEE_OS_ADDITIONAL_VARIABLES="ARCH=arm CFG_BUILT_IN_ARGS=y CFG_PAGEABLE_ADDR=0 CFG_NS_ENTRY_ADDR=0x12000000 CFG_DT_ADDR=0x18000000 CFG_DT=y CFG_PSCI_ARM32=y DEBUG=y CFG_TEE_CORE_LOG_LEVEL=4 CFG_BOOT_SYNC_CPU=n CFG_BOOT_SECONDARY_REQUEST=y CFG_VIRTUALIZATION=n"
BR2_TARGET_UBOOT=y
BR2_TARGET_UBOOT_BUILD_SYSTEM_KCONFIG=y
BR2_TARGET_UBOOT_CUSTOM_TARBALL=y
BR2_TARGET_UBOOT_CUSTOM_TARBALL_LOCATION="https://github.com/boundarydevices/u-boot-imx6/archive/e27d3240.tar.gz"
BR2_TARGET_UBOOT_BOARD_DEFCONFIG="nitrogen6q"
BR2_TARGET_UBOOT_FORMAT_IMX=y
BR2_PACKAGE_HOST_GENIMAGE=y
BR2_PACKAGE_HOST_UBOOT_TOOLS=y
BR2_PACKAGE_HOST_UBOOT_TOOLS_BOOT_SCRIPT=y
BR2_PACKAGE_HOST_UBOOT_TOOLS_BOOT_SCRIPT_SOURCE="$(BR2_EXTERNAL_BOUNDARY_PATH)/board/boundarydevices/mainline/bootscript-optee.txt"
BR2_PACKAGE_SHARED_SECURE_PERIPHERALS=y
```

## package/benchmarker/Config.in
```kconfig
config BR2_PACKAGE_BENCHMARKER
	bool "benchmarker"
	depends on BR2_PACKAGE_SHARED_SECURE_PERIPHERALS
	help
	  A simple benchmarker.

	  https://github.com/Distrinet-TACOS/shared-secure-peripherals
```

## package/fs-load/Config.in
```kconfig
config BR2_PACKAGE_FS_LOAD
	bool "fs-load"
	help
	  TEE Supplicant plugin to load files from the REE file system.

	  UUId: b9b4b4c7-983f-497a-9fdc-f5df864f29c4

		#define TA_UUID
        	{ 0xb9b4b4c7, 0x983f, 0x497a, \
                { 0x9f, 0xdc, 0xf5, 0xdf, 0x86, 0x4f, 0x29, 0xc4} }

	  https://github.com/Distrinet-TACOS/shared-secure-peripherals
```

## package/linux-watchdog/Config.in
```kconfig
config BR2_PACKAGE_LINUX_WATCHDOG
	bool "linux-watchdog"
	help
	  Application to trigger the Linux watchdog.

	  https://github.com/Distrinet-TACOS/shared-secure-peripherals
```

## package/normal-controller/Config.in
```kconfig
config BR2_PACKAGE_NORMAL_CONTROLLER
	bool "normal-controller"
	depends on BR2_PACKAGE_SHARED_SECURE_PERIPHERALS
	help
	  The normal world controller for shared secure peripherals.

	  https://github.com/Distrinet-TACOS/shared-secure-peripherals
```

## package/normal-ssp-driver/Config.in
```kconfig
config BR2_PACKAGE_NORMAL_SSP_DRIVER
	bool "normal-ssp-driver"
	depends on BR2_PACKAGE_SHARED_SECURE_PERIPHERALS
	help
	  The example normal world driver for a shared secure peripheral.

	  https://github.com/Distrinet-TACOS/shared-secure-peripherals
```
